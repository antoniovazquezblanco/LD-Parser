/*
This is a comment.
A multiline comment.
*/
PROVIDE ( ASymbol = 0x00000000 );
PROVIDE ( AnotherSymbol = 0x12345678 );
PROVIDE ( ASymbolWithNumbers123 = 0xaabbccdd );
PROVIDE ( underscores_in_name = 0xAABBCCDD );
PROVIDE ( _start_with_underscore = 1234123 );
PROVIDE ( MAYUS_SYMBOL = 012341234 );
PROVIDE ( dec_suffix_k = 1234K );
PROVIDE ( dec_suffix_m = 1234M );
